## CMakeLists.txt
```
# SPDX-License-Identifier: Apache-2.0

cmake_minimum_required(VERSION 3.13.1)
include($ENV{ZEPHYR_BASE}/cmake/app/boilerplate.cmake NO_POLICY_SCOPE)
project(zbacrux_new_app)

target_include_directories(app PRIVATE include)
target_include_directories(app PRIVATE src)
target_include_directories(app PRIVATE src/utils/cJSON)
#target_include_directories(app PRIVATE src/display3/FT_Esd_Framework)
#target_include_directories(app PRIVATE src/display3/FT_Esd_Widgets)
#target_include_directories(app PRIVATE src/display3/FT_Eve_Hal)
#target_include_directories(app PRIVATE src/display3/FT_Eve_Hal/Hdr)
#target_include_directories(app PRIVATE src/display3/MenuPage)

FILE(GLOB app_src_top src/*.c)
FILE(GLOB utils_cjson src/utils/cJSON/cJSON.c)

target_sources(app PRIVATE ${app_src_top})
target_sources(app PRIVATE ${utils_cjson})
```

## prj.conf
```kconfig
#CONFIG_SW_VERSION="0.1"

#CONFIG_FLOAT=y

CONFIG_LEGACY_DEVICETREE_MACROS=y

#CONFIG_BT=y
#CONFIG_BT_DEBUG_LOG=y
#CONFIG_BT_PERIPHERAL=y
#CONFIG_BT_DEVICE_NAME="ZedBlox Acrux"
#CONFIG_BT_SETTINGS=y

CONFIG_CONSOLE=y
CONFIG_UART_CONSOLE=n

#CONFIG_LOG_STRDUP_MAX_STRING=512

CONFIG_HEAP_MEM_POOL_SIZE=16384

# Enable RTT
CONFIG_USE_SEGGER_RTT=y
CONFIG_RTT_CONSOLE=y

#CONFIG_STDOUT_CONSOLE=y
#CONFIG_USB=y
#CONFIG_USB_DEVICE_STACK=y
#CONFIG_USB_DEVICE_PRODUCT="Zephyr CDC ACM"
CONFIG_LOG=y
#CONFIG_USB_DRIVER_LOG_LEVEL_ERR=y
#CONFIG_USB_CDC_ACM=y
CONFIG_UART_INTERRUPT_DRIVEN=y
CONFIG_UART_LINE_CTRL=y

CONFIG_NEWLIB_LIBC=y

CONFIG_SERIAL_SUPPORT_INTERRUPT=y
CONFIG_NETWORKING=y
CONFIG_NET_SOCKETS=y
CONFIG_NET_SOCKETS_OFFLOAD=y
CONFIG_NET_IPV4=y
CONFIG_NET_TCP=y
CONFIG_NET_SOCKETS_POSIX_NAMES=y
CONFIG_MODEM=y
CONFIG_MODEM_A9GRDA=y

CONFIG_FLASH=y
CONFIG_SPI=y
CONFIG_SPI_ASYNC=y
CONFIG_SPI_NRFX=y
CONFIG_SPI_2=y
CONFIG_SPI_3=y

CONFIG_PWM=y
CONFIG_I2C=y
CONFIG_GPIO_SX1509B=y

CONFIG_SENSOR=y
#CONFIG_BME280=y
CONFIG_HDC2080=y
CONFIG_ICM20600=y
#CONFIG_ICM20600_GPIO_DEV_NAME="GPIO_P0"
#CONFIG_ICM20600_GPIO_PIN_NUM=13
CONFIG_ICM20600_I2C_MASTER_DEV_NAME="I2C_0"

CONFIG_QSPI_FLASH_MX25RXX=y
CONFIG_FLASH_PAGE_LAYOUT=y
CONFIG_FLASH=y
CONFIG_FLASH_MAP=y

CONFIG_NRF_RTC_TIMER=y

CONFIG_MPU_ALLOW_FLASH_WRITE=y
CONFIG_FCB=y
CONFIG_NVS=y

#CONFIG_NO_OPTIMIZATIONS=y

CONFIG_MAIN_STACK_SIZE=2048

#CONFIG_ENTROPY_DEVICE_RANDOM_GENERATOR=y

# Test config
#CONFIG_DISPLAY_TEST=y
#CONFIG_PWM_TEST=n
#CONFIG_IMU_TEST=n
```

## include/app_cfg.h
```c
#ifndef __APP_CFG_H__
#define __APP_CFG_H__

#include <zephyr.h>
#include <device.h>
#include <stdio.h>
#include <sys/printk.h>
#include "app_modem.h"
#include "config_params.h"
#include "app_log.h"

struct app_config
{
    struct device *modem_dev;
    struct device *imu_dev;
    struct device *env1_dev;
    struct device *env2_dev;
    struct device *flash_dev;
    struct device *pwm_dev;
    struct device *uart1_dev;
    struct device *gpio0_dev;
    struct device *gpio1_dev;
    struct device *gpio_p0_dev;
    struct device *display_dev;

    struct global_params __aligned(4) g_params;
    struct device_params __aligned(4) dev_params;

    struct modem_cfg mdm_cfg;
    //struct display_cfg disp_cfg;
    //struct compressor_cfg comp_cfg;
};

int app_init(struct app_config *app_cfg);
void get_global_params(struct global_params** g_params);
void get_device_params(struct device_params** dev_params);
void led_toggle();

#endif
```

## include/app_modem.h
```c
#ifndef __APP_MODEM_H__
#define __APP_MODEM_H__

#include "config_params.h"

/* TODO Move important defines to prj.cfg */
#define MAX_URL_SIZE 512U
#define MAX_BODY_SIZE 4000U
#define MAX_MISC_SIZE 255U
#define MAX_RECV_RESP_BUF 2048U

struct modem_cfg
{
    struct device_params *dev_params;
    struct global_params *g_params;

    struct k_sem serv_resp_sem;
};

int login_device(struct device* modem_dev, struct modem_cfg *mdm_cfg);
int send_device_data(struct device* modem_dev, struct modem_cfg *mdm_cfg);

#endif
```

## include/config_params.h
```c
#ifndef __CONFIG_PARAMS_H__
#define __CONFIG_PARAMS_H__

#include <zephyr.h>

#define MAX_URL_SERVER_SIZE  256U
#define MAX_DEVICE_ID_SIZE   32U
#define MAX_PH_NUM_SIZE      32U
#define MAX_SMS_CODE_SIZE    32U
#define MAX_VERSION_SIZE     32U
#define MAX_KEY_SIZE         256U

/* 
 * not more than MAX_DATA_BATCH_SIZE can be batched
 * in a single server call
 */
#define MAX_DATA_BATCH_SIZE  8U
#define MAX_BATCHED_DATA_SIZE 3200U

struct global_params
{
    const char* sys_version;
    char srv_version[MAX_VERSION_SIZE];
    char auth_key[MAX_KEY_SIZE];
    char date_time_srv[MAX_VERSION_SIZE];
    u32_t system_clock;
    char sys_datetime[MAX_VERSION_SIZE];
    char app_err_msg[MAX_KEY_SIZE];
    u8_t update_pending;
    u16_t target_temp;

    u16_t rbt_cnt;
    u16_t app_err_cnt;
    /* 
     * device flags
     * 0: reboot flag,
     * 1: app_error flag,
     * 2: 
     * rsvd
     */
    u8_t dev_flags;
};

/* all the elements in this struct need to be word aligned */
struct device_params
{
    char primary_server[MAX_URL_SERVER_SIZE];
    char secondary_server[MAX_URL_SERVER_SIZE];
    u16_t port;
    u16_t reserved_0;
    char provision_url[MAX_URL_SERVER_SIZE];
    char login_url[MAX_URL_SERVER_SIZE];
    char send_data_url[MAX_URL_SERVER_SIZE];
    char dev_id[MAX_DEVICE_ID_SIZE];
    char sim_id[MAX_DEVICE_ID_SIZE];
    char ph_num[MAX_PH_NUM_SIZE];
    u32_t upload_interval;
    u32_t data_interval;
    char sms_code[MAX_SMS_CODE_SIZE];
    char post_sms_num[MAX_PH_NUM_SIZE];
};

#if 0
struct config_params
{
    size_t offset;
    size_t len;
};

#define PRIMARY_SERVER_OFFSET        0U
#define SECONDARY_SERVER_OFFSET      256U
#define SERVER_PORT_OFFSET           260U
#define PROVISION_URL_OFFSET         516U 
#define LOGIN_URL_OFFSET             772U
#define SEND_DATA_URL_OFFSET         1028U
#define DEVICE_ID_OFFSET             1540U
#define SIM_ID_OFFSET                1572U
#define PHONE_NUMBER_OFFSET          1604U
#define UPLOAD_INTERVAL_OFFSET       1620U
#define DATA_INTERVAL_OFFSET         1622U
#define SMS_CODE_OFFSET              1624U
#define POST_SMS_NUMBER_OFFSET       1640U
#define NEXT_OFFSET                  1656U

#define UINT16_SIZE             2U

#define PRIMARY_SERVER_SIZE     MAX_URL_SERVER_SIZE
#define SECONDARY_SERVER_SIZE   MAX_URL_SERVER_SIZE
#define SERVER_PORT_SIZE        UINT16_SIZE
#define PROVISION_URL_SIZE      MAX_URL_SERVER_SIZE
#define LOGIN_URL_SIZE          MAX_URL_SERVER_SIZE
#define SEND_DATA_URL_SIZE      MAX_URL_SERVER_SIZE
#define DEVICE_ID_SIZE          MAX_DEVICE_ID_SIZE
#define SIM_ID_SIZE             MAX_DEVICE_ID_SIZE
#define PHONE_NUMBER_SIZE       MAX_PH_NUM_SIZE
#define UPLOAD_INTERVAL_SIZE    UINT16_SIZE
#define DATA_INTERVAL_SIZE      UINT16_SIZE
#define SMS_CODE_SIZE           MAX_SMS_CODE_SIZE
#define POST_SMS_NUMBER_SIZE    MAX_PH_NUM_SIZE

u16_t cfg_get_offset(u8_t cfg_param_idx);
u16_t cfg_get_len(u8_t cfg_param_idx);

#endif

enum config_param_id
{
    PRIMARY_SERVER = 0,
    SECONDARY_SERVER,
    SERVER_PORT,
    PROVISION_URL,
    LOGIN_URL,
    SEND_DATA_URL,
    DEVICE_ID,
    SIM_ID,
    PHONE_NUMBER,
    UPLOAD_INTERVAL,
    DATA_INTERVAL,
    SMS_CODE,
    POST_SMS_NUMBER,
};

/* */
int dev_settings_init();

/* data ptr needs to be word aligned */
int update_settings(u8_t cfg_param_idx, u8_t *data,
        u16_t len);

/* data ptr needs to be word aligned */
int fetch_settings(u8_t cfg_param_idx, u8_t *data,
        u16_t len);

#endif
```

## include/data_process.h
```c
#ifndef __DATA_PROCESS_H__
#define __DATA_PROCESS_H__

#include "dev_fmt.h"
#include "app_modem.h"
#include "config_params.h"

enum parse_type {
    LOGIN_DEVICE = 0,
    SEND_DATA,
    TRIP_DEVICE
};

/* 
 * The child i.e. level + 1; should come immediately after parent
 * of level.
 */
struct json_fmt_desc {
	const char *key;
	u8_t level;
    void* data;
};

int parse_server_response(struct modem_cfg *mdm_cfg,
        u8_t *data, u8_t type);
int encode_data(u8_t type, struct modem_cfg *mdm_cfg,
        u8_t* buf, u16_t buf_sz);

#endif
```

## include/sensor.h
```c
#ifndef __SENSOR_H__
#define __SENSOR_H__

#define MAX_COORDINATE_SIZE 16U

struct env_data {
	u16_t ambient_tmp; /* (temperature * 100) deg C */
	u16_t internal_tmp; /* (temperature * 100) deg C */
	u16_t ambient_hum; /* (humidity * 100) deg C */
	u16_t internal_hum; /* (humidity * 100) deg C */
	u16_t reserved[8]; /* reserved */
};

struct gps_data {
	char lat[MAX_COORDINATE_SIZE];
	char lon[MAX_COORDINATE_SIZE];
	char speed[MAX_COORDINATE_SIZE];
	u16_t sats_tracked;
	u16_t fix_type;
};

struct imu_data {
	/* x1000*/
	u16_t roll;
	u16_t pitch;
	u16_t yaw;
	u16_t accel_x;
	u16_t accel_y;
	u16_t accel_z;
	u16_t gyro_x;
	u16_t gyro_y;
	u16_t gyro_z;
};

struct mech_data {
	u16_t rpm;
	u16_t temp;
	u16_t door_open_time;
	u16_t reserved[8];
};

struct elec_data {
	u16_t voltage;
	u16_t current_mch;
	u16_t current_brd;
	u16_t led_on_time;
	u16_t fan_on_time;
	u16_t compressor_on_time;
	u16_t display_on_time;
	u16_t io_cnt;
};

struct bat_data
{
    u16_t percent;
    u16_t volt_mv;
};

struct sensor_data {
	struct gps_data gps;
	struct env_data env;
	struct imu_data imu;
	struct mech_data mch;
	struct elec_data elc;
    struct bat_data bat;
};

extern struct device *imu_dev;

#endif
```

## src/app.c
```c
#include <zephyr.h>
#include <kernel.h>
#include <stdio.h>
#include <stdlib.h>
#include <string.h>
#include "app_cfg.h"
#include "dev_data.h"
#include <drivers/gpio.h>

#define APP_SYS_VERSION      "v1.0"
//#define MDM_THREAD_STACK_SIZE 8192
//#define MDM_THREAD_PRIORITY 7

#define MAX_RETRY_COUNT        5U

//K_THREAD_STACK_DEFINE(mdm_thread_stack, MDM_THREAD_STACK_SIZE);

static void data_upload_cb(struct k_timer *dummy);

K_TIMER_DEFINE(data_upload_timer, data_upload_cb, NULL);

//struct k_thread mdm_thread_data;
//k_tid_t mdm_tid;

//static struct k_timer mdm_timer;

static struct app_config app_cfg;

static struct k_sem sem_mdm_trigger;

void get_global_params(struct global_params** g_params)
{
    *g_params = &(app_cfg.g_params);
}

void get_device_params(struct device_params** dev_params)
{
    *dev_params = &(app_cfg.dev_params);
}

static void data_upload_cb(struct k_timer *dummy)
{
    k_sem_give(&sem_mdm_trigger);
}

void led_toggle()
{
    gpio_pin_write(app_cfg.gpio_p0_dev, 0, 0);
    k_sleep(50);
    gpio_pin_write(app_cfg.gpio_p0_dev, 0, 1);
}

#if 0
void mdm_thread(void *param, void *arg1, void *arg2)
{
	ARG_UNUSED(arg1);
	ARG_UNUSED(arg2);
	ARG_UNUSED(param);
    int ret = 0;
    int retry_cnt = MAX_RETRY_COUNT;

    while (retry_cnt--)
    {
        ret = login_device(app_cfg.modem_dev, &app_cfg.mdm_cfg);
        if (ret != 0)
        {
            error_log("Cloud login failed");
        }
    }

    /* one shot timer */
    k_timer_start(&data_upload_timer, app_cfg.dev_params.upload_interval, 0);

    while(1)
    {
        k_sem_take(&sem_mdm_trigger, K_FOREVER);

        ret = send_device_data(app_cfg.modem_dev, app_cfg.mdm_cfg);
        if (ret != 0)
        {
            error_log("cloud upload failed");
        }

        /* one shot timer */
        k_timer_start(&data_upload_timer, app_cfg.dev_params.upload_interval, 0);
    }
}
#endif

int main(void)
{
    int ret = 0;
    int retry_cnt = 1;//MAX_RETRY_COUNT;

    app_cfg.g_params.sys_version = APP_SYS_VERSION;

    ret = app_init(&app_cfg);
    if (ret != 0)
    {
        error_log("app init failed");
    }

    gpio_pin_configure(app_cfg.gpio_p0_dev, 0, GPIO_DIR_OUT);

    k_sem_init(&sem_mdm_trigger, 1, 1);

#if 0
	mdm_tid = k_thread_create(&mdm_thread_data, mdm_thread_stack,
				 K_THREAD_STACK_SIZEOF(mdm_thread_stack),
				 mdm_thread, NULL, NULL, NULL,
				 MDM_THREAD_PRIORITY, 0, K_NO_WAIT);
    if (!mdm_tid)
    {
        error_log("mdm thread create failed!");
    }
#endif

    while (retry_cnt--)
    {
        info_log("login device");

        ret = login_device(app_cfg.modem_dev, &app_cfg.mdm_cfg);
        if (ret != 0)
        {
            error_log("Cloud login failed");
        }

        k_sleep(5000);
    }

    /* one shot timer */
    //k_timer_start(&data_upload_timer, K_MSEC(app_cfg.dev_params.upload_interval), 0);

    while(1)
    {
        k_sem_take(&sem_mdm_trigger, K_FOREVER);

        info_log("send device data");

        ret = send_device_data(app_cfg.modem_dev, &app_cfg.mdm_cfg);
        if (ret != 0)
        {
            error_log("cloud upload failed");
            fetch_unit_rollback();
        }

        /* one shot timer */
        k_timer_start(&data_upload_timer, K_MSEC(app_cfg.dev_params.upload_interval), 0);
    }

    return 0;
}
```

## src/app_compressor.c
```c
/*
 * SPDX-License-Identifier: Apache-2.0
 */

#include <zephyr.h>
#include <device.h>
#include <drivers/uart.h>
#include <drivers/gpio.h>
#include <string.h>
#include "app_compressor.h"
#include "dev_data.h"

#define COMP_RX_BUFFER_SIZE        32U
#define MAX_DELTA_DEG_C            4U
#define MAX_NEGATIVE_TEMP          30

struct compressor_data
{
    struct device* compressor_dev;
    struct device* gpio_dev;

    struct compressor_rx_data c_rx_data;
    u16_t set_speed;
    int32_t current_temp; /* deg C * 100 */
    int32_t target_temp; /* deg C * 100 */
};

static struct k_sem rx_sem;
static struct compressor_data c_data;

/* RX thread structures */
K_THREAD_STACK_DEFINE(com_rx_stack, 1024);
struct k_thread com_rx_thread;

static u8_t c_rx_buf[COMP_RX_BUFFER_SIZE];
static u16_t c_rx_wr_idx = 0;
static u16_t c_rx_rd_idx = 0;
static u16_t c_rx_cnt = 0;

static u8_t bldc_host_fmt[16] = {
    0xAA, 0x00, 0x00, /* 0：Power off 1：Power on */
    0x00, /* Low speed setting */
    0x00, /* High speed setting */
    0x00, 0x00, 0x00, 0x00, 0x00,
    0x00, 0x00, 0x00, 0x00,
    0x00, /* checksum */
    0x55
};

static inline void rx_buf_put(u16_t sz)
{
    c_rx_wr_idx += sz;
    if (c_rx_wr_idx >= COMP_RX_BUFFER_SIZE)
    {
        c_rx_wr_idx = c_rx_wr_idx % COMP_RX_BUFFER_SIZE;
    }

    c_rx_cnt += sz;
}

static inline void rx_buf_get(u16_t sz)
{
    c_rx_rd_idx += sz;
    if (c_rx_rd_idx >= COMP_RX_BUFFER_SIZE)
    {
        c_rx_rd_idx = c_rx_rd_idx % COMP_RX_BUFFER_SIZE;
    }

    c_rx_cnt -= sz;
}

/**
 * @brief  External Communication interrupt handler.
 *
 * @note   Fills interfaces ring buffer with received data.
 *         When ring buffer is full the data is discarded.
 *
 * @param  *cmpsr_data->compressor_dev: uart device.
 *
 * @retval None.
 */
static void com_uart_isr(struct device* compressor_dev)
{
    int rx = 0, ret;

    /* get all of the data off UART as fast as we can */
    while (uart_irq_update(compressor_dev)
            && uart_irq_is_pending(compressor_dev)
            && uart_irq_rx_ready(compressor_dev)) {
        ret = uart_fifo_read(compressor_dev, c_rx_buf + c_rx_wr_idx,
                sizeof(c_rx_buf) - c_rx_cnt);
        if (ret > 0)
        {
             rx_buf_put(ret);
        }
    }

    k_sem_give(&rx_sem);
}

static int com_uart_write(struct device *compressor_dev, const u8_t *buf,
              size_t size)
{
    if (size == 0) {
        return 0;
    }

    do {
        uart_poll_out(compressor_dev, *buf++);
    } while (--size);

    return 0;
}


static void bldc_power(u8_t on)
{
    bldc_host_fmt[2] = on;
}

static void bldc_calc_checksum()
{
    u8_t cksm = 0;

    for (int i = 0; i < 14; i++) {
        cksm += bldc_host_fmt[i];
    }

    bldc_host_fmt[14] = cksm;
}

static void set_rpm(u16_t rpm)
{
    if (rpm < MIN_RPM || rpm > MAX_RPM) {
        printk("Invalid rpm value");
    }

    bldc_host_fmt[3] = rpm & 0xFF;
    bldc_host_fmt[4] = (rpm >> 8) & 0xFF;
}

#if 0
static u16_t get_rpm()
{
    return ((bldc_host_fmt[4] << 8) | bldc_host_fmt[3]);
}
#endif

static int bldc_start(u16_t rpm)
{
    int ret;

    bldc_power(1);
    set_rpm(rpm);
    bldc_calc_checksum();

    ret = com_uart_write(c_data.compressor_dev, bldc_host_fmt, 16);

    return ret;
}

static int bldc_stop()
{
    int ret;

    bldc_power(0);
    bldc_calc_checksum();

    ret = com_uart_write(c_data.compressor_dev, bldc_host_fmt, 16);

    return ret;
}

/**
 * @brief  Drains UART.
 *
 * @note   Discards remaining data.
 *
 * @param  *iface: modem interface.
 *
 * @retval None.
 */
static void com_uart_flush(struct device* compressor_dev)
{
    u8_t c;

    while (uart_fifo_read(compressor_dev, &c, 1) > 0) {
        continue;
    }
}

static void pid_run()
{
    float cur_temp = c_data.current_temp / 100;
    float tgt_temp = c_data.target_temp / 100;

    if (c_data.target_temp < -MAX_NEGATIVE_TEMP)
    {
        c_data.set_speed = 0;
        return;
    }

    /* this pid func assumes current_temp and target_temp are in deg celcius */
    if (cur_temp > tgt_temp + MAX_DELTA_DEG_C)
    {
        c_data.set_speed = MAX_RPM;
    }
    else if (cur_temp >= tgt_temp)
    {
        c_data.set_speed = (MAX_RPM / 100) - (((MAX_RPM - MIN_RPM) / (MAX_DELTA_DEG_C * 100))
                * (MAX_DELTA_DEG_C + tgt_temp - cur_temp));
        c_data.set_speed *= 100;
    }
    else if (cur_temp < tgt_temp)
    {
        c_data.set_speed = 0;
    }

    if (c_data.set_speed < MIN_RPM)
    {
        c_data.set_speed = 0;
    }
    
    if (c_data.set_speed > MAX_RPM)
    {
        c_data.set_speed = MAX_RPM;
    }
}

#define EFFECTIVE_INDEX(i, max)   (i % max)
/* RX thread */
static void com_rx(void)
{
    while (true) {
        /* wait for incoming data */
        k_sem_take(&rx_sem, K_FOREVER);

        /* current temperature update constantly */
        get_current_temp_internal(&c_data.current_temp);

        if (c_rx_cnt >= 16)
        {
            while ((c_rx_buf[c_rx_rd_idx] != 0xAA) && (c_rx_cnt >= 16))
            {
                info_log("no");
                rx_buf_get(1);
            }

            if (c_rx_cnt < 16)
            {
                continue;
            }

            info_log("y, 0x%x", c_rx_buf[EFFECTIVE_INDEX(c_rx_rd_idx + 15, COMP_RX_BUFFER_SIZE)]);
            if (c_rx_buf[EFFECTIVE_INDEX(c_rx_rd_idx + 15, COMP_RX_BUFFER_SIZE)] == 0x55)
            {
                info_log("yes");
                c_data.c_rx_data.comp_cur_speed = 
                    ((c_rx_buf[EFFECTIVE_INDEX(c_rx_rd_idx + 3, COMP_RX_BUFFER_SIZE)] << 8)
                        | c_rx_buf[EFFECTIVE_INDEX(c_rx_rd_idx + 2, COMP_RX_BUFFER_SIZE)]);
                c_data.c_rx_data.comp_cur_current = 
                    ((c_rx_buf[EFFECTIVE_INDEX(c_rx_rd_idx + 5, COMP_RX_BUFFER_SIZE)] << 8)
                    | c_rx_buf[EFFECTIVE_INDEX(c_rx_rd_idx + 4, COMP_RX_BUFFER_SIZE)]);
                c_data.c_rx_data.bus_volt = 
                    ((c_rx_buf[EFFECTIVE_INDEX(c_rx_rd_idx + 7, COMP_RX_BUFFER_SIZE)] << 8)
                        | c_rx_buf[EFFECTIVE_INDEX(c_rx_rd_idx + 6, COMP_RX_BUFFER_SIZE)]);
                c_data.c_rx_data.drv_temp = c_rx_buf[EFFECTIVE_INDEX(c_rx_rd_idx + 8, COMP_RX_BUFFER_SIZE)];
                c_data.c_rx_data.drv_err = c_rx_buf[EFFECTIVE_INDEX(c_rx_rd_idx + 9, COMP_RX_BUFFER_SIZE)];
                c_data.c_rx_data.drv_cnd = c_rx_buf[EFFECTIVE_INDEX(c_rx_rd_idx + 10, COMP_RX_BUFFER_SIZE)];

                rx_buf_get(16);

                /* check rpm needed */
                pid_run();

                info_log("ss: %d, cs: %d, cc: %d, bv: %d, dt: %d, de: %d, dc: %d",
                        c_data.set_speed, c_data.c_rx_data.comp_cur_speed,
                        c_data.c_rx_data.comp_cur_current, c_data.c_rx_data.bus_volt,
                        c_data.c_rx_data.drv_temp, c_data.c_rx_data.drv_err,
                        c_data.c_rx_data.drv_cnd);

                /* send host frame */
                if (c_data.set_speed <= MIN_RPM)
                {
                    bldc_stop();
                }
                else if (c_data.set_speed <= MAX_RPM)
                {
                    bldc_start(c_data.set_speed);
                }
                else
                {
                    error_log("something wrong with pid loop, speed out of range");
                }
            }
            else
            {
                info_log("no2");
                rx_buf_get(1);
            }
        }

        /* give up time if we have a solid stream of data */
        k_yield();
    }
}

void compressor_set_target_temp(int32_t temp)
{
    c_data.target_temp = temp;
}

int compressor_init(struct device* compressor_dev, struct device* gpio)
{
    int ret = 0;

    if (compressor_dev == NULL)
    {
        error_log("invalid compressor device");
        return -1;
    }

    /* enable 5V conversion */
    gpio_pin_configure(gpio, UART_5V_ENABLE_PIN, GPIO_DIR_OUT);
    gpio_pin_write(gpio, UART_5V_ENABLE_PIN, 1);

    k_sem_init(&rx_sem, 0, 1);

    uart_irq_rx_disable(compressor_dev);
    uart_irq_tx_disable(compressor_dev);
    com_uart_flush(compressor_dev);
    uart_irq_callback_set(compressor_dev, com_uart_isr);
    uart_irq_rx_enable(compressor_dev);

    memset(&c_data, 0, sizeof(struct compressor_data));

    c_data.compressor_dev = compressor_dev;
    c_data.gpio_dev = gpio;

    /* get current_temp_ptr */
    get_current_temp_internal(&c_data.current_temp);

    /* start RX thread */
    k_thread_create(&com_rx_thread, com_rx_stack,
            K_THREAD_STACK_SIZEOF(com_rx_stack),
            (k_thread_entry_t)com_rx, NULL, NULL, NULL,
            K_PRIO_COOP(COMPRESSOR_UART_INT_PRIO), 0, K_NO_WAIT);

    bldc_start(MAX_RPM);

    info_log("compressor started\n");

    return 0;
}

void get_compressor_data(struct compressor_rx_data** comp)
{
    *comp = &c_data.c_rx_data;
}
```

## src/app_compressor.h
```c
#ifndef __APP_COMPRESSOR_H__
#define __APP_COMPRESSOR_H__

#include "app_cfg.h"

#define UART_5V_ENABLE_PIN         12
#define COMPRESSOR_UART_INT_PRIO   6
#define MIN_RPM                    1800
#define MAX_RPM                    3000

struct compressor_rx_data
{
    u16_t comp_cur_speed;
    u16_t comp_cur_current;
    u16_t bus_volt;
    u8_t drv_temp;
    u8_t drv_err;
    u8_t drv_cnd;
};

void compressor_set_target_temp(int32_t temp);
int compressor_init(struct device* compressor_dev, struct device* gpio);
void get_compressor_data(struct compressor_rx_data** comp);

#endif
```

## src/app_init.c
```c
#include "app_cfg.h"
#include "app_compressor.h"
#include "cJSON.h"
#include "dev_data.h"
#include "app_io.h"
#include <string.h>

#define MAX_INT_NEG_32    0xf0000000

static cJSON_Hooks zephyr_hooks = {
    k_malloc,
    k_free
};

int app_init(struct app_config *app_cfg)
{
    struct sensor_dev sensor_devs;

    int ret = 0;

    /* general init */
    cJSON_InitHooks(&zephyr_hooks);

    app_cfg->modem_dev = device_get_binding(DT_INST_0_RDA_A9G_LABEL);
    app_cfg->imu_dev = device_get_binding(DT_INST_0_INVENSENSE_ICM20XXX_LABEL);
    app_cfg->flash_dev = device_get_binding(DT_INST_0_QSPI_MX25RXX_LABEL);
    app_cfg->gpio0_dev = device_get_binding(DT_ALIAS_GPIO_0_LABEL);
    app_cfg->gpio1_dev = device_get_binding(DT_ALIAS_GPIO_1_LABEL);
    app_cfg->gpio_p0_dev = device_get_binding(DT_INST_0_SEMTECH_SX1509B_LABEL);
    app_cfg->uart1_dev = device_get_binding(DT_ALIAS_UART_1_LABEL);
    app_cfg->pwm_dev = device_get_binding(DT_ALIAS_PWM_0_LABEL);
    app_cfg->display_dev = device_get_binding(DT_SPI_3_NAME);
    app_cfg->env1_dev = device_get_binding(DT_INST_1_BOSCH_BME280_LABEL);
    app_cfg->env2_dev = device_get_binding(DT_INST_0_BOSCH_BME280_LABEL);

    app_cfg->mdm_cfg.dev_params = &app_cfg->dev_params;
    app_cfg->mdm_cfg.g_params = &app_cfg->g_params;

    /* fetch settings from storage */
    ret = dev_settings_init();
    if (ret != 0)
    {
        error_log("dev settings init failed");
    }

    fetch_settings(PRIMARY_SERVER, app_cfg->dev_params.primary_server,
            MAX_URL_SERVER_SIZE);
    /* FIXME  Hack */
    strcpy(app_cfg->dev_params.primary_server, "https://ec2-54-187-232-160.us-west-2.compute.amazonaws.com:3000");
    fetch_settings(SECONDARY_SERVER, app_cfg->dev_params.secondary_server,
            MAX_URL_SERVER_SIZE);
    fetch_settings(SERVER_PORT, (u8_t *) &app_cfg->dev_params.port,
            sizeof(u32_t));
    fetch_settings(PROVISION_URL, app_cfg->dev_params.provision_url,
            MAX_URL_SERVER_SIZE);
    fetch_settings(LOGIN_URL, app_cfg->dev_params.login_url,
            MAX_URL_SERVER_SIZE);
    fetch_settings(SEND_DATA_URL, app_cfg->dev_params.send_data_url,
            MAX_URL_SERVER_SIZE);
    fetch_settings(DEVICE_ID, app_cfg->dev_params.dev_id,
            MAX_DEVICE_ID_SIZE);
    fetch_settings(SIM_ID, app_cfg->dev_params.sim_id,
            MAX_DEVICE_ID_SIZE);
    fetch_settings(PHONE_NUMBER, app_cfg->dev_params.ph_num,
            MAX_PH_NUM_SIZE);
    fetch_settings(UPLOAD_INTERVAL, (u8_t *) &app_cfg->dev_params.upload_interval,
            sizeof(u32_t));
    fetch_settings(DATA_INTERVAL, (u8_t *) &app_cfg->dev_params.data_interval,
            sizeof(u32_t));
    fetch_settings(SMS_CODE, app_cfg->dev_params.sms_code,
            MAX_SMS_CODE_SIZE);
    fetch_settings(POST_SMS_NUMBER, app_cfg->dev_params.post_sms_num,
            MAX_PH_NUM_SIZE);

    info_log("%s", app_cfg->dev_params.primary_server);
    info_log("%s", app_cfg->dev_params.secondary_server);
    info_log("%s", app_cfg->dev_params.provision_url);
    info_log("%s", app_cfg->dev_params.login_url);
    info_log("%s", app_cfg->dev_params.send_data_url);
    info_log("%s", app_cfg->dev_params.dev_id);
    info_log("%s", app_cfg->dev_params.sim_id);
    info_log("%s", app_cfg->dev_params.ph_num);
    info_log("%d", app_cfg->dev_params.upload_interval);
    info_log("%d", app_cfg->dev_params.data_interval);
    info_log("%s", app_cfg->dev_params.sms_code);
    info_log("%s", app_cfg->dev_params.post_sms_num);

    /* FIXME display init */
    //ret = display_init(display_dev, gpio0_dev);

    /* io init */
    ret = app_io_init(app_cfg->gpio_p0_dev, app_cfg->pwm_dev);

    /* */
    sensor_devs.env1_dev = app_cfg->env1_dev;
    sensor_devs.env2_dev = app_cfg->env2_dev;
    sensor_devs.imu_dev = app_cfg->imu_dev;
    sensor_devs.gps_dev = app_cfg->modem_dev;

    info_log("Init dev_data");

    /* dev data init */
    ret = dev_data_init(&sensor_devs);

    info_log("Init compressor");

    /* control systems init */
    ret = compressor_init(app_cfg->uart1_dev, app_cfg->gpio_p0_dev);

    /* DO NOT start compressor until instructed */
    //compressor_set_target_temp(MAX_INT_NEG_32);
    /* FIXME Testing tgt temp 5 */
    compressor_set_target_temp(500);

    return ret;
}

#if 0

	gpio_pin_configure(gpio, 11, GPIO_DIR_OUT);
    gpio_pin_write(gpio, 11, 1);

	gpio_pin_configure(gpio, 0, GPIO_DIR_OUT);
    gpio_pin_write(gpio, 0, 0);
    k_sleep(1000);
    gpio_pin_write(gpio, 0, 1);

	pwm = device_get_binding("PWM_0");

#if 0
	k_work_init(&beep_work, beep);
	/* Notify with a beep that we've started */
	k_work_submit(&beep_work);
#endif
    u32_t period, min_period, max_period;
    u64_t cycles;

	/* Adjust max_period depending pwm capabilities */
	pwm_get_cycles_per_sec(pwm, BUZZER_PIN, &cycles);
	/* in very worst case, PWM has a 8 bit resolution and count up to 256 */
	period = max_period = 256 * USEC_PER_SEC / cycles;
	min_period = max_period / 64;

	pwm_pin_set_usec(pwm, BUZZER_PIN, 250, 125);
    k_sleep(5000);
	pwm_pin_set_usec(pwm, BUZZER_PIN, 124, 62);
    k_sleep(5000);
	pwm_pin_set_usec(pwm, BUZZER_PIN, 62, 31);
    k_sleep(5000);
	pwm_pin_set_usec(pwm, BUZZER_PIN, 30, 15);
    k_sleep(5000);
#endif
```

## src/app_io.c
```c
#include "app_io.h"

static void button_pressed(struct device *dev, struct gpio_callback *cb,
			   u32_t pins)
{

	if (pins & BIT(DT_ALIAS_SW0_GPIOS_PIN)) {
	} else {
	}
}

int app_io_init(struct device* gpio, struct device* pwm)
{
    int ret = 0;
	static struct gpio_callback button_cb;

    if (!gpio || !pwm)
    {
        error_log("GPIO IO null\n");
        return -1;
    }

	ret = gpio_pin_configure(gpio, DT_ALIAS_SW0_GPIOS_PIN,
			   (GPIO_DIR_IN | GPIO_PUD_PULL_UP | GPIO_INT | GPIO_INT_EDGE |
			    GPIO_INT_ACTIVE_LOW));
    if (ret != 0)
    {
        error_log("%d, %d", __LINE__, ret);
    }

	ret = gpio_pin_configure(gpio, DT_ALIAS_SW1_GPIOS_PIN,
			   (GPIO_DIR_IN | GPIO_PUD_PULL_UP | GPIO_INT | GPIO_INT_EDGE |
			    GPIO_INT_ACTIVE_LOW));
    if (ret != 0)
    {
        error_log("%d, %d", __LINE__, ret);
    }

	ret = gpio_pin_configure(gpio, DT_ALIAS_SW2_GPIOS_PIN,
			   (GPIO_DIR_IN | GPIO_PUD_PULL_UP | GPIO_INT | GPIO_INT_EDGE |
			    GPIO_INT_ACTIVE_LOW));
    if (ret != 0)
    {
        error_log("%d, %d", __LINE__, ret);
    }

	ret = gpio_pin_configure(gpio, DT_ALIAS_SW3_GPIOS_PIN,
			   (GPIO_DIR_IN | GPIO_PUD_PULL_UP | GPIO_INT | GPIO_INT_EDGE |
			    GPIO_INT_ACTIVE_LOW));
    if (ret != 0)
    {
        error_log("%d, %d", __LINE__, ret);
    }

	gpio_init_callback(&button_cb, button_pressed,
			   BIT(DT_ALIAS_SW0_GPIOS_PIN) | BIT(DT_ALIAS_SW1_GPIOS_PIN) |
			   BIT(DT_ALIAS_SW2_GPIOS_PIN) | BIT(DT_ALIAS_SW3_GPIOS_PIN));

	ret = gpio_add_callback(gpio, &button_cb);
    if (ret != 0)
    {
        error_log("%d, %d", __LINE__, ret);
    }

	ret = gpio_pin_enable_callback(gpio, DT_ALIAS_SW0_GPIOS_PIN);
    if (ret != 0)
    {
        error_log("%d, %d", __LINE__, ret);
    }

	ret = gpio_pin_enable_callback(gpio, DT_ALIAS_SW1_GPIOS_PIN);
    if (ret != 0)
    {
        error_log("%d, %d", __LINE__, ret);
    }

	ret = gpio_pin_enable_callback(gpio, DT_ALIAS_SW2_GPIOS_PIN);
    if (ret != 0)
    {
        error_log("%d, %d", __LINE__, ret);
    }

	ret = gpio_pin_enable_callback(gpio, DT_ALIAS_SW3_GPIOS_PIN);
    if (ret != 0)
    {
        error_log("%d, %d", __LINE__, ret);
    }

    return ret;
}
```

## src/app_io.h
```c
#ifndef __APP_IO_H__
#define __APP_IO_H__

#include <zephyr.h>
#include <drivers/gpio.h>
#include <device.h>
#include "app_log.h"

int app_io_init(struct device* gpio, struct device* pwm);

#endif
```

## src/app_log.h
```c
#ifndef __APP_LOG_H__
#define __APP_LOG_H__

#include <zephyr.h>
#include <device.h>
#include <stdio.h>
#include <sys/printk.h>

/* FIXME move to appropriate place */
#define LOG_STDOUT

#ifdef LOG_STDOUT
#define error_log(fmt, ...)   printk(fmt"\n", ##__VA_ARGS__)
#define info_log(fmt, ...)    printk(fmt"\n", ##__VA_ARGS__)
#endif

#endif
```
