## boards/arm/zb_tv_h723zi/Kconfig.zb_tv_h723zi
```kconfig
# SPDX-License-Identifier: Apache-2.0

config BOARD_ZB_TV_H723ZI
	select SOC_STM32H723XX
```

## boards/arm/zb_tv_h723zi/zb_tv_h723zi_defconfig
```kconfig
# SPDX-License-Identifier: Apache-2.0

CONFIG_SYS_CLOCK_HW_CYCLES_PER_SEC=80000000
#CONFIG_SYS_CLOCK_HW_CYCLES_PER_SEC=256000000

# Enable MPU
CONFIG_ARM_MPU=y

# Enable HW stack protection
CONFIG_HW_STACK_PROTECTION=y

# Enable UART
CONFIG_SERIAL=y

# Console
CONFIG_CONSOLE=y
CONFIG_UART_CONSOLE=y

# enable pin controller
CONFIG_PINCTRL=y

# Enable GPIO
CONFIG_GPIO=y

# Enable clocks
CONFIG_CLOCK_CONTROL=y
```

## boards/arm/zb_tv_h743zi/Kconfig.zb_tv_h743zi
```kconfig
# SPDX-License-Identifier: Apache-2.0

config BOARD_ZB_TV_H743ZI
	select SOC_STM32H743XX
```

## dts/bindings/modem/quectel,bg95.yaml
```yaml
# Copyright (c) 2023 Bjarki Arge Andreasen
# SPDX-License-Identifier: Apache-2.0

description: Quectel BG95 modem

compatible: "quectel,bg95"

include: uart-device.yaml

properties:
    label:
      required: true

    mdm-power-gpios:
      type: phandle-array
      required: true

    mdm-reset-gpios:
      type: phandle-array
      required: true

    mdm-dtr-gpios:
      type: phandle-array
      required: false

    mdm-wdisable-gpios:
      type: phandle-array
      required: false
```
