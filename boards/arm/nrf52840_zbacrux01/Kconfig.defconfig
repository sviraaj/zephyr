## boards/arm/nrf52840_zbacrux01/Kconfig.defconfig
```kconfig
# Kconfig - nRF52840 PCA10056 board configuration
#
# Copyright (c) 2016 Nordic Semiconductor ASA
#
# SPDX-License-Identifier: Apache-2.0

if BOARD_NRF52840_ZBACRUX01

config BOARD
	default "nrf52840_zb_acrux01"

if ADC

config ADC_0
	default y

endif # ADC

if I2C

config I2C_0
	default y

config I2C_1
	default y

if I2C_0

choice I2C_0_NRF_TYPE
    default I2C_0_NRF_TWIM
endchoice

endif # I2C_0

if I2C_1

choice I2C_1_NRF_TYPE
    default I2C_1_NRF_TWIM
endchoice

config GPIO_SX1509B
    default y

config GPIO_SX1509B_INIT_PRIORITY
    default 70

endif # I2C_1

endif # I2C

if PWM

config PWM_0
	default y

endif # PWM

if SPI

config SPI_1
	default y

config SPI_2
	default y

endif # SPI

if USB

config USB_NRF52840
	default y

config USB_DEVICE_STACK
	default y

endif # USB

if IEEE802154

config IEEE802154_NRF5
	default y

endif # IEEE802154

config BT_CTLR
	default BT

endif # BOARD_NRF52840_PCA10056
```

## boards/arm/nrf52840_zbacrux02/Kconfig
```kconfig
# Kconfig - nRF52840 ZBACRUX board configuration
#
# Copyright (c) 2019 ZedBlox Logitech Pvt Ltd
#
# SPDX-License-Identifier: Apache-2.0

config BOARD_ENABLE_DCDC
    bool "Enable DCDC mode"
    select SOC_DCDC_NRF52X
    default y
    depends on BOARD_NRF52840_ZBACRUX02
```

## boards/arm/nrf52840_zbacrux02/Kconfig.defconfig
```kconfig
# Kconfig - nRF52840 PCA10056 board configuration
#
# Copyright (c) 2016 Nordic Semiconductor ASA
#
# SPDX-License-Identifier: Apache-2.0

if BOARD_NRF52840_ZBACRUX02

config BOARD
	default "nrf52840_zb_acrux02"

if USB

config USB_NRFX
	default y

config USB_DEVICE_STACK
	default y

endif # USB

config IEEE802154_NRF5
	default y
	depends on IEEE802154

config BT_CTLR
	default BT

endif
```

## boards/arm/nrf52840_zbacrux02/nrf52840_zbacrux02_defconfig
```kconfig
# SPDX-License-Identifier: Apache-2.0

CONFIG_SOC_SERIES_NRF52X=y
CONFIG_SOC_NRF52840_QIAA=y
CONFIG_BOARD_NRF52840_ZBACRUX02=y

# Enable MPU
CONFIG_ARM_MPU=y

# additional board options
CONFIG_GPIO=y
CONFIG_GPIO_AS_PINRESET=n
```

## boards/arm/nrf52840_zbacrux04/Kconfig.board
```kconfig
# Kconfig - nRF52840 PCA10056 board configuration
#
# Copyright (c) 2016 Nordic Semiconductor ASA
#
# SPDX-License-Identifier: Apache-2.0

config  BOARD_NRF52840_ZBACRUX04
	bool "NRF52840 ZBACRUX04"
	depends on SOC_NRF52840_QIAA
```

## boards/arm/nrf52840_zbpollux/Kconfig
```kconfig
if BOARD_NRF52840_ZBPOLLUX

config BOARD_ENABLE_DCDC
        bool "Enable DCDC mode"
        select SOC_DCDC_NRF52X
        default y

endif # BOARD_NRF52840_ZBPOLLUX
```

## boards/arm/nrf52840_zbpollux/Kconfig.board
```kconfig
config  BOARD_NRF52840_ZBPOLLUX
	bool "NRF52840 ZBPOLLUX"
	depends on SOC_NRF52840_QIAA
```

## boards/arm/nrf52840_zbpollux/Kconfig.defconfig
```kconfig
if BOARD_NRF52840_ZBPOLLUX

config BOARD
	default "nrf52840_zb_pollux"

if ADC

config ADC_0
	default y

endif # ADC

if I2C

config I2C_0
	default y

config I2C_1
	default y

if I2C_0

choice I2C_0_NRF_TYPE
    default I2C_0_NRF_TWIM
endchoice

endif # I2C_0

if I2C_1

choice I2C_1_NRF_TYPE
    default I2C_1_NRF_TWIM
endchoice

config GPIO_SX1509B
    default n

config GPIO_SX1509B_INIT_PRIORITY
    default 70

endif # I2C_1

endif # I2C

if PWM

config PWM_0
	default y

endif # PWM

if SPI

config SPI_2
	default y

config SPI_3
	default y

endif # SPI

if USB

config USB_DEVICE_STACK
	default y

endif # USB

if IEEE802154

config IEEE802154_NRF5
	default y

endif # IEEE802154

config BT_CTLR
	default BT

endif
```

## boards/arm/nrf52840_zbpollux/nrf52840_zbpollux_defconfig
```kconfig
# SPDX-License-Identifier: Apache-2.0

CONFIG_SOC_SERIES_NRF52X=y
CONFIG_SOC_NRF52840_QIAA=y
CONFIG_BOARD_NRF52840_ZBPOLLUX=y

# Enable MPU
CONFIG_ARM_MPU=y

# additional board options
CONFIG_GPIO=y
CONFIG_GPIO_AS_PINRESET=n

# enable uart driver
CONFIG_SERIAL=y
CONFIG_UART_0_NRF_UART=y
```

## boards/arm/nrf52840_zbpuck01/Kconfig.board
```kconfig
# SPDX-License-Identifier: Apache-2.0

config  BOARD_NRF52840_ZBPUCK01
	bool "NRF52840 ZBPUCK01"
	depends on SOC_NRF52840_QIAA
```

## drivers/flash/Kconfig.mx25rxx
```kconfig
#
# Copyright (c) 2019 ZedBlox Ltd
#
# SPDX-License-Identifier: Apache-2.0
#

menuconfig QSPI_FLASH_MX25RXX
	bool "QSPI NOR Flash Macronix MX25RXX"
	select FLASH_HAS_DRIVER_ENABLED
    select NRFX_QSPI

if QSPI_FLASH_MX25RXX

config QSPI_FLASH_MX25RXX_INIT_PRIORITY
	int
	default 80
	help
	  Device driver initialization priority.
	  Device is connected to SPI bus, it has to
	  be initialized after SPI driver.

config QSPI_FLASH_MX25RXX_FLASH_SIZE
	int "Flash size in bytes"
	default 8388608
	help
	  This is the flash capacity in bytes.

config QSPI_FLASH_MX25RXX_PAGE_PROGRAM_SIZE
	int "Page Program Size in bytes"
	default 256
	help
	  This is the maximum size of a page program operation. Writing data
	  over this page boundary will split the write operation into two
	  pages.

endif # QSPI_FLASH_MX25RXX
```

## drivers/sensor/adxl357/Kconfig
```kconfig
# Micropower, 3-Axis, +/-200g Digital Accelerometer

# Copyright (c) 2018 Analog Devices Inc.
# SPDX-License-Identifier: Apache-2.0

menuconfig ADXL357
	bool "ADXL357 Three Axis High-g I2C/SPI accelerometer"
	depends on (I2C && HAS_DTS_I2C) || SPI
	help
	  Enable driver for ADXL357 Three-Axis Digital Accelerometers.

if ADXL357

choice ADXL357_BUS_TYPE
	prompt "Interface type"
	help
	  Select interface the digital interface type for the ADXL357

config ADXL357_I2C
	depends on I2C
	bool "I2C Interface"

config ADXL357_SPI
	depends on SPI
	bool "SPI Interface"

endchoice

choice
	prompt "Operating mode"
	default ADXL357_PEAK_DETECT_MODE

config ADXL357_PEAK_DETECT_MODE
	bool "Max Peak detect mode"
	help
	  In most high-g applications, a single (3-axis) acceleration sample at
	  the peak of an impact event contains sufficient information
	  about the event, and the full acceleration history is not required.
	  In this mode the device returns only the over threshold
	  Peak Acceleration between two consecutive sample fetches.

config ADXL357_MEASUREMENT_MODE
	bool "Measurement Mode"
	help
	  In this mode, acceleration data is provided continuously at the
	  output data rate (ODR).

endchoice

choice
	prompt "Accelerometer sampling frequency (ODR)"
	default ADXL357_ODR_6400HZ if ADXL357_PEAK_DETECT_MODE
	default ADXL357_ODR_400HZ if ADXL357_MEASUREMENT_MODE

config ADXL357_ODR_400HZ
	bool "400 Hz"

config ADXL357_ODR_800HZ
	bool "800 Hz"

config ADXL357_ODR_1600HZ
	bool "1600 Hz"

config ADXL357_ODR_3200HZ
	bool "3200 Hz"

config ADXL357_ODR_6400HZ
	bool "6400 Hz"

endchoice

choice
	prompt "Low-Pass (Antialiasing) Filter corner frequency"
	default ADXL357_BW_200HZ if ADXL357_ODR_400HZ
	default ADXL357_BW_400HZ if ADXL357_ODR_800HZ
	default ADXL357_BW_800HZ if ADXL357_ODR_1600HZ
	default ADXL357_BW_1600HZ if ADXL357_ODR_3200HZ
	default ADXL357_BW_3200HZ if ADXL357_ODR_6400HZ
	help
	  High g events often include acceleration content over a wide range
	  of frequencies. The ADC of the ADXL357 samples the input acceleration
	  at the user selected ODR.
	  In the absence of antialiasing filters, input signals whose frequency
	  is more than half the ODR alias or fold into the measurement bandwidth
	  can lead to inaccurate measurements.

config ADXL357_LPF_DISABLE
	bool "Disabled"

config ADXL357_BW_200HZ
	bool "200 Hz"

config ADXL357_BW_400HZ
	bool "400 Hz"

config ADXL357_BW_800HZ
	bool "800 Hz"

config ADXL357_BW_1600HZ
	bool "1600 Hz"

config ADXL357_BW_3200HZ
	bool "3200 Hz"

endchoice

choice
	prompt "High-Pass Filter corner frequency"
	default ADXL357_HPF_CORNER0
	help
	  The ADXL357 offers a one-pole, high-pass filter with a user
	  selectable −3 dB frequency. Applications that do not require dc
	  acceleration measurements can use the high-pass filter to minimize
	  constant or slow varying offset errors including initial bias,
	  bias drift due to temperature, and bias drift due to supply voltage

config ADXL357_HPF_DISABLE
	bool "Disabled"

config ADXL357_HPF_CORNER0
	bool "ODR/210"

config ADXL357_HPF_CORNER1
	bool "ODR/411"

config ADXL357_HPF_CORNER2
	bool "ODR/812"

config ADXL357_HPF_CORNER3
	bool "ODR/1616"

endchoice


config ADXL357_ACTIVITY_THRESHOLD
	int "Activity threshold in mg"
	range 0 200000
	default 500
	help
	  Threshold for activity detection.

config ADXL357_INACTIVITY_THRESHOLD
	int "In-activity threshold in mg"
	range 0 200000
	default 400
	help
	  Threshold for in-activity detection.

config ADXL357_ACTIVITY_TIME
	int "Activity time"
	range 0 255
	default 1
	help
	  The activity timer implements a robust activity detection that
	  minimizes false positive motion triggers. When the timer is used,
	  only sustained motion can trigger activity detection.
	  Number of multiples of 3.3 ms activity timer for which above threshold
	  acceleration is required to detect activity. It is 3.3 ms per code
	  for 6400 Hz ODR, and it is 6.6 ms per code for 3200 Hz ODR and below.

config ADXL357_INACTIVITY_TIME
	int "In-activity time"
	range 0 255
	default 2
	help
	  The time that all enabled axes must be lower than the inactivity
	  threshold for an inactivity event to be detected. Number of multiples
	  of 26 ms inactivity timer for which below threshold acceleration is
	  required to detect inactivity. It is 26 ms per code for 3200 Hz ODR
	  and below, and it is 13 ms per code for 6400 Hz ODR.

config ADXL357_REFERENCED_ACTIVITY_DETECTION_MODE
	bool "Use referenced activity/in-activity detection"
	default y
	help
	  Activity detection can be configured as referenced or absolute.
	  When using absolute activity detection, acceleration samples are
	  compared directly to a user set threshold to determine whether
	  motion is present. In many applications, it is advantageous for
	  activity detection to be based not on an absolute threshold,
	  but on a deviation from a reference point or orientation.

choice
	prompt "Trigger mode"
	default ADXL357_TRIGGER_NONE
	help
	  Specify the type of triggering used by the driver.

config ADXL357_TRIGGER_NONE
	bool "No trigger"

config ADXL357_TRIGGER_GLOBAL_THREAD
	bool "Use global thread"
	depends on GPIO
	select ADXL357_TRIGGER

config ADXL357_TRIGGER_OWN_THREAD
	bool "Use own thread"
	depends on GPIO
	select ADXL357_TRIGGER

endchoice

config ADXL357_TRIGGER
	bool

config ADXL357_THREAD_PRIORITY
	int "Thread priority"
	depends on ADXL357_TRIGGER_OWN_THREAD && ADXL357_TRIGGER
	default 10
	help
	  Priority of thread used by the driver to handle interrupts.

config ADXL357_THREAD_STACK_SIZE
	int "Thread stack size"
	depends on ADXL357_TRIGGER_OWN_THREAD && ADXL357_TRIGGER
	default 1024
	help
	  Stack size of thread used by the driver to handle interrupts.

endif # ADXL357
```

## drivers/sensor/icm20600/Kconfig
```kconfig
# Kconfig - ICM20600 Six-Axis Motion Tracking device configuration options

#
# SPDX-License-Identifier: Apache-2.0
#

menuconfig ICM20600
	bool "ICM20600 Six-Axis Motion Tracking Device"
	depends on I2C
	help
	  Enable driver for ICM20600 I2C-based six-axis motion tracking device.

if ICM20600

config ICM20600_NAME
	string "Driver name"
	default "ICM20600"
	help
	  Device name with which the ICM20600 sensor is identified.

config ICM20600_I2C_ADDR
	hex "I2C address"
	default 0x68
	range 0x68 0x69
	help
	  I2C address of the ICM20600 sensor.
	  Choose 0x68 if the AD0 pin is pulled to GND or 0x69 if the AD0 pin
	  is pulled to VDD.

config ICM20600_I2C_MASTER_DEV_NAME
	string "I2C master where ICM20600 is connected"
	default "I2C_0"
	help
	  Specify the device name of the I2C master device to which ICM20600 is
	  connected.

choice
	prompt "Trigger mode"
	default ICM20600_TRIGGER_NONE#ICM20600_TRIGGER_GLOBAL_THREAD
	help
	  Specify the type of triggering to be used by the driver.

config ICM20600_TRIGGER_NONE
	bool "No trigger"

config ICM20600_TRIGGER_GLOBAL_THREAD
	bool "Use global thread"
	depends on GPIO
	select ICM20600_TRIGGER

config ICM20600_TRIGGER_OWN_THREAD
	bool "Use own thread"
	depends on GPIO
	select ICM20600_TRIGGER

endchoice

config ICM20600_TRIGGER
	bool

config ICM20600_GPIO_DEV_NAME
	string "GPIO device"
	default "GPIO_0"
	depends on ICM20600_TRIGGER
	help
	  The device name of the GPIO device to which the ICM20600 interrupt pin
	  is connected.

config ICM20600_GPIO_PIN_NUM
	int "Interrupt GPIO pin number"
	default 0
	depends on ICM20600_TRIGGER
	help
	  The number of the GPIO on which the interrupt signal from the ICM20600
	  chip will be received.

config ICM20600_THREAD_PRIORITY
	int "Thread priority"
	depends on ICM20600_TRIGGER_OWN_THREAD
	default 10
	help
	  Priority of thread used by the driver to handle interrupts.

config ICM20600_THREAD_STACK_SIZE
	int "Thread stack size"
	depends on ICM20600_TRIGGER_OWN_THREAD
	default 1024
	help
	  Stack size of thread used by the driver to handle interrupts.

config ICM20600_ACCEL_FS
	int "Accelerometer full-scale range"
	default 2
	help
	  Magnetometer full-scale range.
	  An X value for the config represents a range of +/- X g. Valid
	  values are 2, 4, 8 and 16.

config ICM20600_GYRO_FS
	int "Gyroscope full-scale range"
	default 250
	help
	  Gyroscope full-scale range.
	  An X value for the config represents a range of +/- X degrees/second.
	  Valid values are 250, 500, 1000, 2000.

endif # ICM20600
```

## dts/bindings/modem/rda,a9g.yaml
```yaml
description: >
    This is a representation of the rda a9g modem.

compatible: "rda,a9g"

include: uart-device.yaml

properties:
    label:
      required: true

    mdm-power-gpios:
      type: phandle-array
      required: true

    mdm-reset-gpios:
      type: phandle-array
      required: true

    mdm-vint-gpios:
      type: phandle-array
      required: false
```

## dts/bindings/mtd/macronix,mx25rxx.yaml
```yaml
description: >
    Macronix MX25RXX QSPI flash device

compatible: "macronix,mx25rxx"

#include: qspi-device.yaml
include: base.yaml

properties:
    label:
      required: true

    jedec-id:
      type: uint8-array
      required: false
      description: JEDEC ID as manufacturer ID, memory type, memory density

    has-be32k:
      type: boolean
      required: false
      description: Indicates the device supports the BE32K command

    size:
      type: int
      required: false
      description: flash capacity in bits
```

## dts/bindings/sensor/invensense,icm20xxx.yaml
```yaml
# SPDX-License-Identifier: Apache-2.0

description: >
    This binding gives a base representation of ICM20xxx IMU

compatible: "invensense,icm20xxx"

include: i2c-device.yaml

properties:
    irq-gpios:
      type: phandle-array
      required: false
```

## dts/bindings/sensor/ti,hdc2080.yaml
```yaml
# Copyright (c) 2020, ZedBlox logitech Pvt Ltd
# SPDX-License-Identifier: Apache-2.0

description: HDC2080 sensor

compatible: "ti,hdc2080"

include: i2c-device.yaml
```
